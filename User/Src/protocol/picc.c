#include "main.h"

struct picc_run_t picc_run = {
    .en = 1,
};

#if 0
#define ZHI_FU_BAO
uint8_t t2t_mem[][4] =
    {
#ifndef ZHI_FU_BAO
        {0xAC, 0xDC, 0x2A, 0x7A},
        {0x6A, 0x64, 0x34, 0x80},
        {0xBA, 0x00, 0x00, 0x00},
        {0xE1, 0x10, 0x6d, 0x00}, // cc 字节 byte3 :
        {0x03, 0x16, 0xD1, 0x01},
        // 网址信息
        {0x12, 0x55, 0x01, 0x6d},
        {0x65, 0x67, 0x61, 0x68},
        {0x75, 0x6e, 0x74, 0x6d},
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        {0x00, 0x00, 0x00, 0x00},
#else
        {0xAC, 0xDC, 0x2A, 0x7A},
        {0x6A, 0x64, 0x34, 0x80},
        {0xBA, 0x00, 0x00, 0x00},
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        {0x00, 0x00, 0x00, 0x00},
#endif
};
#endif

t4t_entity t4t_tag = {0};
const uint16_t au16FSD_CODE[] = {16, 24, 32, 40, 48, 64, 96, 128, 256};

uint8_t t2t_ecc[32] = {0x96, 0xF3, 0x0D, 0x59, 0xA1, 0x28, 0x6E, 0xD0, 0x22, 0x5F, 0xEE, 0x46, 0xBB, 0x75, 0x31, 0x3D,
                       0x79, 0x70, 0x3D, 0xD7, 0x0C, 0x1D, 0xF6, 0x11, 0x12, 0x9F, 0xBF, 0xA3, 0xCF, 0x52, 0x8C, 0xAD};

uint8_t t2t_ver[8] = {0x00, 0x04, 0x04, 0x02, 0x01, 0x00, 0x13, 0x03};

static uint8_t picc_get_err(void)
{
    return nfc_get_reg(0, 0x06, 1);
}

uint8_t data_test[64] = {0xbb, 0xbb, 1, 1, 1, 1, 1, 1, 1, 1, 1, 1, 2, 2, 2, 2, 2, 2, 2, 2, 2, 2,
                         3, 3, 3, 3, 3, 3, 3, 3, 3, 3, 4, 4, 4, 4, 4, 4, 4, 4, 4, 4,
                         5, 5, 5, 5, 5, 5, 5, 5, 5, 5, 6, 6, 6, 6, 6, 6, 6, 6, 6, 6,
                         0xdd, 0xdd}; //{0xbb,0xbb,1,1,1,1,1,1,0xdd,0xdd};

uint8_t if_picc_state_active(void)
{
    return (picc_run.state >= PICC_STATE_ACTIVE);
}

void build_web_uri(t4t_entity *tag, const char *url)
{

    ndef_uri_record *record = (ndef_uri_record *)&tag->ndef_data[tag->file_count * sizeof(ndef_uri_record)];
    record->header = 0xD1; // MB=1, ME=1, TNF=0x01
    record->type_len = 1;
    record->type = 'U';
    record->uri_prefix = 0x01; // "http://www."

    strncpy(record->uri, url, sizeof(record->uri));
    record->uri_len = 1 + strlen(url); // 前缀+URL长度
    record->ndef_len = (4 + (uint16_t)record->uri_len) >> 8 | (4 + (uint16_t)record->uri_len) << 8;
}

void init_t4t_entity(t4t_entity *tag)
{
    // 初始化CC文件
    tag->files[0] = (file_entry){
        .fid = 0xE103, .type = 2, .size = 15, .start_block = 0, .access_mode = 0x01};
    // 预置CC文件内容（参考NFC Forum T4T规范）
    uint8_t cc_data[] = {0x00, 0x0F, 0x20, 0x00, 0xFA, 0x00, 0xFA, 0x04, 0x06, 0xE1, 0x04, 0x7F, 0xFF, 0x00, 0x00};
    memcpy(tag->ndef_data, cc_data, sizeof(cc_data));
    tag->file_count++;

    // 初始化NDEF文件
    tag->files[1] = (file_entry){
        .fid = 0xE104, .type = 2, .size = sizeof(ndef_uri_record), .start_block = 1, .access_mode = 0x03};
    build_web_uri(tag, "megahuntmicro.com"); // 默认网址
    tag->file_count++;
}

void picc_write(uint8_t *buf, uint16_t len)
{
    tick start;

    nfc_clear_bit(8, 0x3e, 0x20, 1);
    nfc_set_bit(8, 0x3e, 0x10, 1);
    NFC_LOG("PICC Send data:%d\r\n", len);
    for (int i = 0; i < len; i++)
        NFC_LOG("%02x ", buf[i]);
    NFC_LOG("\r\n");

    for (uint16_t j = 0; j < len; j++)
    {
        nfc_write_reg(REG_FIFODATA, buf[j]);
    }
    // transmit command
    nfc_set_reg(0, 0x1, 4, 0);
    start = get_tick();
    while (!nfc_check_bit(0, 0x04, PICC_TxIrq, 0) && (nfc_check_bit(8, 0x3e, 6, 1)))
    {
        if (is_timeout(start, 30))
        {
            break;
        }
    }
    nfc_set_bit(0, 0x04, PICC_TxIrq, 0);
    nfc_set_bit(8, 0x3e, 0x20, 1);
}

void picc_t4t_send_r(block_prologue_field_t *p)
{
    uint8_t len = 0;
    // PCB
    picc_run.tx_buf[len++] = p->PCB.val;
    // cid
    if (p->PCB.val & BIT3)
        picc_run.tx_buf[len++] = p->cid;

    picc_run.tx_len = len;
    picc_write(picc_run.tx_buf, picc_run.tx_len);

    picc_blk_num_set(p->PCB.val & BIT0);
}

void set_picc_init(void)
{
    picc_run.en = PICC_MODE_ENABLE;
    picc_run.state = PICC_STATE_INIT;
}

void handle_read(t4t_entity *tag, c_apdu_t *cmd, r_apdu_t *resp)
{
    uint16_t offset = (cmd->p1 << 8) | cmd->p2;

    if (offset + cmd->le.ext_le > tag->cur_file->size)
    {
        resp->sw = 0x6A84; // 地址越界
        return;
    }

    // 从存储块读取数据（支持跨块读取）
    resp->data = &tag->ndef_data[tag->cur_file->start_block * sizeof(ndef_uri_record) + offset];
    resp->len = cmd->le.ext_le;
    resp->sw = 0x9000; // 成功状态
}

file_entry *find_file(t4t_entity *tag, uint16_t fid)
{
    for (uint8_t i = 0; i < tag->file_count; i++)
    {
        if (tag->files[i].fid == fid)
            return &tag->files[i];
    }
    return NULL;
}

void handle_select(t4t_entity *tag, c_apdu_t *cmd, r_apdu_t *resp)
{
    if (cmd->lc.ext_lc == 2)
    {
        tag->cur_file = find_file(tag, cmd->data[0] << 8 | cmd->data[1]);
        if (tag->cur_file)
        {
            resp->sw = 0x9000; // 成功状态码
        }
    }
    else if (cmd->lc.ext_lc == 7 && memcmp(cmd->data, "\xD2\x76\x00\x00\x85\x01\x01", 7) == 0)
    {                      // NDEF应用选择
        resp->sw = 0x9000; // 成功响应
    }
    else
    {
        resp->sw = 0x6A82; // 文件未找到
    }
}

int parse_capdu(const uint8_t *apdu, uint16_t len, c_apdu_t *cmd)
{
    if (len < 4)
        return -1; // 基础头校验

    // 解析固定头
    cmd->cla = apdu[0];
    cmd->ins = apdu[1];
    cmd->p1 = apdu[2];
    cmd->p2 = apdu[3];
    uint8_t offset = 4;

    cmd->lc_type = 0; // 无Lc
    // 处理Lc/Data部分
    if ((offset + 1) < len && apdu[offset] != 0x00)
    { // 短Lc
        cmd->lc_type = 1;
        cmd->lc.short_lc = apdu[offset++];
        cmd->data = &apdu[offset];
        offset += cmd->lc.short_lc;
    }
    else if ((offset + 3) < len && apdu[offset] == 0x00)
    { // 扩展Lc
        cmd->lc_type = 2;
        cmd->lc.ext_lc = (apdu[offset + 1] << 8) | apdu[offset + 2];
        offset += 3;
        cmd->data = &apdu[offset];
        offset += cmd->lc.ext_lc;
    }

    // 处理Le部分
    if (offset < len)
    {
        if ((offset + 1) == len)
        { // 短Le
            cmd->le_type = 1;
            cmd->le.short_le = apdu[offset++];
        }
        else if ((offset + 2) == len)
        {
            if (cmd->lc_type != 2)
                return -3;
            cmd->le_type = 3;
            cmd->le.ext_le = (apdu[offset] << 8) | apdu[offset + 1];
            offset += 2;
        }
        else if ((offset + 3) == len)
        {
            if (cmd->lc_type != 1)
                return -4;
            if (apdu[offset] != 0)
                return -5;
            cmd->le_type = 2;
            cmd->le.ext_le = (apdu[offset + 1] << 8) | apdu[offset + 2];
            offset += 3;
        }
    }

    return (offset != len ? -5 : 0);
}

void picc_t4t_send_i(block_prologue_field_t *p, r_apdu_t *r)
{
    uint8_t len = 0;
    // PCB
    picc_run.tx_buf[len++] = p->PCB.val;
    // cid
    if (p->PCB.val & BIT3)
        picc_run.tx_buf[len++] = p->cid;
    // inf
    if (r->len)
    {
        memcpy(&picc_run.tx_buf[len], r->data, r->len);
        len += r->len;
    }
    // sw
    picc_run.tx_buf[len++] = (uint8_t)(r->sw >> 8);
    picc_run.tx_buf[len++] = (uint8_t)(r->sw & 0xff);
    picc_run.tx_len = len;

    picc_write(picc_run.tx_buf, picc_run.tx_len);

    picc_blk_num_set(p->PCB.val & BIT0);
}

static void picc_t4t_deselect(block_prologue_field_t *p)
{
    uint8_t len = 0;
    // PCB
    picc_run.tx_buf[len++] = p->PCB.val;
    // cid
    if (p->PCB.val & BIT3)
        picc_run.tx_buf[len++] = p->cid;

    picc_run.tx_len = len;

    picc_write(picc_run.tx_buf, picc_run.tx_len);
    picc_set_halt();
    pcd_set_rate('1', 'A');
}

void picc_t4t_apdu_process(block_preprocess_t *prep, t4t_entity *tag)
{
    r_apdu_t rapdu = {0};
    c_apdu_t capdu = {0};
    if (prep->valid == 1)
    {
        switch (prep->prologue.PCB.val >> 6)
        {
        case 0: // i block
            if (parse_capdu(prep->data, prep->data_len, &capdu))
            {
                rapdu.sw = 0x6700;
            }
            else
            {
                if (capdu.ins == 0xA4)
                {
                    handle_select(tag, &capdu, &rapdu);
                }
                else if (capdu.ins == 0xB0)
                {
                    handle_read(tag, &capdu, &rapdu);
                }
                else if (capdu.ins == 0xD0)
                {
                }
                else
                {
                    rapdu.sw = 0x6D00;
                }
                picc_t4t_send_i(&prep->prologue, &rapdu);
            }
            break;

        case 2:
            picc_t4t_send_r(&prep->prologue);
            break;

        case 3: // s block
            if (prep->prologue.PCB.s_pcb.func == 0)
            {
                picc_t4t_deselect(&prep->prologue);
            }
            break;
        }
        prep->valid = 0;
    }
}

uint8_t picc_check_cid(uint8_t cid)
{
    return (cid == picc_run.rats.cid);
}

void picc_blk_num_set(uint8_t num)
{
    picc_run.local_blk_num = num;
}

void picc_t2t_ack(void)
{
    nfc_set_bit(9, 0x39, 0x04, 1); // open halt byte send
    picc_write("\x0A", 1);
    nfc_clear_bit(9, 0x39, 0x04, 1); // close halt byte send
}

void picc_reset(void)
{
    NFC_LOG("pr:e\r\n");
    nfc_set_reg(9, 0x3a, 0x80, 1); // reset picc without read-modify-write
    NFC_LOG("pr:d\r\n");
}

void picc_uid_set(uint8_t *uid, uint8_t len)
{
    nfc_set_reg(9, 0x31, uid[0], 1);
    for (uint8_t i = 1; i < 4; i++)
        nfc_set_reg(9, 0x31 + i, uid[i], 0);

    if (len == 7)
    {
        nfc_set_reg(9, 0x35, uid[4], 0);
        nfc_set_reg(9, 0x36, uid[5], 0);
        nfc_set_reg(9, 0x38, uid[6], 0);
        nfc_set_bit(9, 0x39, 1, 0);
    }
}

void picc_cid_set(uint8_t cid)
{
    picc_run.rats.cid = cid;
}

uint8_t picc_run_state_check(picc_state_e state)
{
    return (picc_run.state == state);
}

void picc_run_state(picc_state_e state)
{
    picc_run.state = state;
}

void picc_set_halt(void)
{
    nfc_set_bit(8, 0x3e, 0x08, 1);
    picc_run_state(PICC_STATE_HALT);
}

void picc_set_atqa_hbyte(uint8_t atqa_h)
{
    nfc_set_reg(8, 0x35, atqa_h, 1);
}

void picc_set_atqa_lbyte(uint8_t atqa_l)
{
    nfc_set_reg(8, 0x36, atqa_l & 0x3f, 1);
}

uint8_t picc_blk_num_get(void)
{
    return picc_run.local_blk_num;
}

static void picc_t2t_nak(uint8_t err)
{
    nfc_set_bit(9, 0x39, 0x04, 1); // open halt byte send
    picc_write(&err, 1);
    nfc_clear_bit(9, 0x39, 0x04, 1); // close halt byte send
}

static void picc_t2t_process(void)
{
    switch (picc_run.rx_buf[0])
    {
    case 0x50:
        picc_set_halt();
        break;
    case 0x30:
        // picc_write(t2t_mem[picc_run.rx_buf[1]], 16);
        break;
    case 0x60:
        picc_write(t2t_ver, 8);
        break;
    case 0x3C:
        picc_write(t2t_ecc, 32);
        break;
    case 0x3A:
        // picc_write(t2t_mem[picc_run.rx_buf[1]], (picc_run.rx_buf[2] - picc_run.rx_buf[1] + 1) * 4);
        break;
    case 0x1b:
        picc_write("\x00\x00", 2);
        break;
    case 0x02:
        picc_t2t_nak(0);
        break;
    case 0x03:
        picc_t2t_nak(1);
        break;
    case 0x6a:
        picc_t2t_nak(4);
        break;
    case 0xb2:
        picc_t2t_nak(5);
    case 0xA2:
        // memcpy(t2t_mem[picc_run.rx_buf[1]], &picc_run.rx_buf[2], 4);
        picc_t2t_ack();
        break;
    default:
        break;
    }
}

// block process
/*
return
-1:err
0:i
1:r
2:wtx
3:pps
4:deselect
*/
block_preprocess_t picc_t4t_block_process(uint8_t *rx_buf, uint16_t rx_len)
{
    block_prologue_field_t *rx_prologue = (block_prologue_field_t *)rx_buf;
    block_preprocess_t b_pr = {0};

    if ((rx_prologue->PCB.val & BIT3) == BIT3)
    {
        if (!picc_check_cid(rx_prologue->cid))
        {
            b_pr.valid = 2; // cid err
            return b_pr;
        }
        b_pr.prologue.PCB.val |= BIT3;
        b_pr.prologue.cid = rx_prologue->cid;
    }

    switch (rx_prologue->PCB.val >> 6)
    {
    case 0: // i block
        if ((rx_prologue->PCB.val & PCD_CMD_I_BLOCK_Msk) != PCD_CMD_I_BLOCK)
        {
            b_pr.valid = 3; // i_pcb err
            return b_pr;
        }
        if (rx_prologue->PCB.i_pcb.chain_flg)
        { // R(ACK)
        }
        else
        {
            b_pr.valid = 1;
            b_pr.prologue.PCB.i_pcb.blk_t = 0;
            b_pr.prologue.PCB.i_pcb.fixed1 = 1;
            b_pr.prologue.PCB.i_pcb.blk_num = rx_prologue->PCB.i_pcb.blk_num;
            b_pr.data = &rx_buf[1 + rx_prologue->PCB.i_pcb.cid_flw + rx_prologue->PCB.i_pcb.nad_flw];
            b_pr.data_len = rx_len - 1 - rx_prologue->PCB.i_pcb.cid_flw - rx_prologue->PCB.i_pcb.nad_flw;
        }
        break;
    case 2: // r block
        if ((rx_prologue->PCB.val & PCD_CMD_R_BLOCK_Msk) != PCD_CMD_R_BLOCK)
        {
            b_pr.valid = 4; // r_pcb err
            return b_pr;
        }
        b_pr.valid = 1;
        if (rx_prologue->PCB.r_pcb.blk_num == picc_blk_num_get())
        {
            // block number match,send last i block
        }
        else
        {
            if (rx_prologue->PCB.r_pcb.nak_flg)
            {
                b_pr.prologue.PCB.r_pcb.blk_t = 2;
                b_pr.prologue.PCB.r_pcb.fixed0 = 0;
                b_pr.prologue.PCB.r_pcb.fixed1 = b_pr.prologue.PCB.r_pcb.fixed1_ = 1;
                b_pr.prologue.PCB.r_pcb.blk_num = picc_blk_num_get();
                b_pr.prologue.PCB.r_pcb.nak_flg = 0;
            }
        }
        break;
    case 3: // s block
        if ((rx_prologue->PCB.val & PCD_CMD_S_BLOCK_Msk) != PCD_CMD_S_BLOCK)
        {
            b_pr.valid = 5; // s_pcb err
            return b_pr;
        }
        if (rx_prologue->PCB.s_pcb.func == 3)
        { // wtx
        }
        else if (rx_prologue->PCB.s_pcb.func == 0)
        { // deselect
            b_pr.valid = 1;
            b_pr.prologue.PCB.s_pcb.blk_t = 3;
            b_pr.prologue.PCB.s_pcb.func = 0;
            b_pr.prologue.PCB.s_pcb.fixed0 = b_pr.prologue.PCB.s_pcb.fixed0_ = 0;
            b_pr.prologue.PCB.s_pcb.fixed1 = 1;
        }
        break;
    default:
        return b_pr;
    }
    return b_pr;
}

static void picc_t4t_rats_process(uint8_t *buf, uint16_t len)
{
    if (buf)
    {
        switch (buf[0])
        {
        case 0x50:
            picc_set_halt();
            break;
        case 0xe0:
            picc_cid_set(picc_run.rx_buf[1] & 0x0f);
            picc_run.rats.fsdi = au16FSD_CODE[((picc_run.rx_buf[1] >> 4) > 8) ? 8 : (picc_run.rx_buf[1] >> 4)];
            memcpy(picc_run.tx_buf, &picc_conf.ats, sizeof(struct picc_ats));
            picc_run.tx_len = picc_conf.ats.TL;
            picc_write(picc_run.tx_buf, picc_run.tx_len);
            NFC_LOG("PICC is Activated\r\n");
            picc_blk_num_set(1);
            picc_run_state(PICC_STATE_PPS);
            break;
        default:
            break;
        }
    }
}

void picc_set_rate(uint8_t rate)
{
    rate = rate & 0x3;
    picc_run.rate = rate;
    switch (rate)
    {
    case 0:
        pcd_set_rate('1', 'A');
        break;
    case 1:
        pcd_set_rate('2', 'A');
        break;
    case 2:
        pcd_set_rate('4', 'A');
        break;
    case 3:
        pcd_set_rate('8', 'A');
        break;
    }
}

static uint8_t picc_t4t_pps_process(uint8_t *buf, uint16_t len)
{
    uint8_t ret = 0;
    if (buf)
    {
        pps_t *pps = (pps_t *)buf;
        if ((picc_check_cid(pps->PPSS.bitmap.cid)) &&
            (pps->pps0 == 0x11))
        {
            picc_write(&pps->PPSS.val, 1);
            picc_set_rate(pps->pps1);
            ret = 1;
        }
        else
        {
            ret = 0;
        }
        picc_run_state(PICC_STATE_RECV_BLOCK);
    }
    return ret;
}

static void picc_t4t_process(void)
{
    block_preprocess_t prep = {0};
    if (picc_run_state_check(PICC_STATE_RECV_BLOCK))
    {
        prep = picc_t4t_block_process(picc_run.rx_buf, picc_run.rx_len - 2);
    }
    else if (picc_run_state_check(PICC_STATE_ACTIVE))
    {
        picc_t4t_rats_process(picc_run.rx_buf, picc_run.rx_len);
    }
    else if (picc_run_state_check(PICC_STATE_PPS))
    {
        if (!picc_t4t_pps_process(picc_run.rx_buf, picc_run.rx_len))
            prep = picc_t4t_block_process(picc_run.rx_buf, picc_run.rx_len - 2);
    }
    picc_t4t_apdu_process(&prep, &t4t_tag);
}

void picc_14443_4_enable(uint8_t en)
{
    if (en)
    {
        nfc_set_bit(10, 0x3A, 1, 1);
        nfc_clear_bit(9, 0x3D, 0x80, 1);
        picc_conf.app = picc_t4t_process;
        init_t4t_entity(&t4t_tag);
    }
    else
    {
        nfc_clear_bit(10, 0x3A, 1, 1);
        picc_conf.app = picc_t2t_process;
    }
}

static void picc_event_register(intc_event_e e, picc_event cb)
{
    picc_conf.event[e] = cb;
}

static void picc_event_unregister(intc_event_e e)
{
    picc_conf.event[e] = NULL;
}

// 进场处理
static void picc_field_in_callback(uint32_t event)
{
    NFC_LOG("PICC Field In\r\n");
}

// 使能picc进场中断
void picc_field_in_irq(uint8_t en)
{
    if (en)
    {
        nfc_set_bit(8, 0x3b, 0x04, 1);
        picc_event_register(PICC_FIELD_IN_EVENT, picc_field_in_callback);
    }
    else
    {
        nfc_clear_bit(8, 0x3b, 0x04, 1);
        picc_event_unregister(PICC_FIELD_IN_EVENT);
    }
}

// 离场处理
static void picc_field_out_callback(uint32_t event)
{
    // if (GPIO_ReadInputDataBit(GPIOB, GPIO_Pin_5))
    // {
    // 	mh1612s_card_emu_optimize_out_carrier_callback(opt_hw);
    // }
    NFC_LOG("PICC Field Out\r\n");
}

static void picc_active_callback(uint32_t event)
{
    picc_run_state(PICC_STATE_ACTIVE);
}

uint8_t picc_get_rate(void)
{
    return picc_run.rate;
}

static void picc_inactive_callback(uint32_t event)
{
    if (picc_get_rate())
    {
        picc_set_rate(0);
    }
    picc_run_state(PICC_STATE_IDLE);
}

// 使能picc离场中断
void picc_field_out_irq(uint8_t en)
{
    if (en)
    {
        nfc_set_bit(8, 0x3b, 0x08, 1);
        picc_event_register(PICC_FIELD_OUT_EVENT, picc_field_out_callback);
    }
    else
    {
        nfc_clear_bit(8, 0x3b, 0x08, 1);
        picc_event_unregister(PICC_FIELD_OUT_EVENT);
    }
}

void picc_active_irq(uint8_t en)
{
    if (en)
    {
        nfc_set_bit(8, 0x3e, 0x20, 1);
        picc_event_register(PICC_ACTIVE_EVENT, picc_active_callback);
        picc_event_register(PICC_INACTIVE_EVENT, picc_inactive_callback);
    }
    else
    {
        nfc_clear_bit(8, 0x3e, 0x20, 1);
        picc_event_unregister(PICC_ACTIVE_EVENT);
        picc_event_unregister(PICC_INACTIVE_EVENT);
    }
}

void picc_set_idle(void)
{
    nfc_set_bit(8, 0x3e, 0x10, 1);
    picc_run_state(PICC_STATE_IDLE);
}

static uint16_t picc_get_rx_len(void)
{
    return nfc_get_reg(0, 0x0a, 1);
}

void picc_err_callback(uint32_t event)
{
    NFC_LOG("err:%x\n", picc_get_err());
    picc_set_idle();
}

// poll rx irq
void picc_rx_callback(uint32_t event)
{
    picc_run.rx_len = picc_get_rx_len();
    if (picc_run.rx_len)
    {
        NFC_LOG("PICC Recv data:%d\r\n", picc_run.rx_len);
        for (int i = 0; i < picc_run.rx_len; i++)
            picc_run.rx_buf[i] = nfc_get_reg(0, 0x09, 1);
        for (int i = 0; i < picc_run.rx_len; i++)
            NFC_LOG("%02x ", picc_run.rx_buf[i]);
        NFC_LOG("\r\n");
    }
    else
    {
        nfc_set_reg(0, 1, 0x8, 0);
        return;
    }
    if (!(event & (1 << ERR_EVENT)))
    {
        picc_conf.app();
    }
    else
    {
        picc_err_callback(event);
    }
}

void picc_rx_irq(uint8_t en, process_handle cb)
{
    uint8_t i;
    if (en)
    {
        intc_irq_register(RX_EVENT, cb);
        hal_nfc_bit_set(0, 0x02, PICC_RxIEn, 1);
    }
    else
    {
        hal_nfc_bit_clear(8, 0x02, PICC_RxIEn, 1);
        intc_irq_unregister(RX_EVENT);
    }
}

void picc_t2t_read_callback(uint32_t event)
{

    NFC_LOG(" I am picc \r\n");
    picc_run.rx_len = picc_get_rx_len();
    if (picc_run.rx_len)
    {
        NFC_LOG("PICC Recv data:%d\r\n", picc_run.rx_len);
        for (int i = 0; i < picc_run.rx_len; i++)
        {
            picc_run.rx_buf[i] = hal_nfc_get_register(0, 0x09, 1);
        }

        if (picc_run.rx_buf[0] == 0xaa && picc_run.rx_buf[1] == 0xaa)
        {
            // for(int j = 0;j < 10;j++){
            // NFC_LOG("%02x ", picc_run.rx_buf[j]);}
            // NFC_LOG("\r\n");
            hal_nfc_clear_register_bit(REG_TXMODE, BIT(7)); // 不使能发送crc
            hal_nfc_clear_register_bit(REG_RXMODE, BIT(7)); // 不使能接收crc
            picc_write(data_test, sizeof(data_test));
        }
        if (!(event & (1 << ERR_EVENT)))
        {
            // picc_t2t_process(picc_run.rx_buf);
        }
        else
        {
            picc_err_callback(event);
            NFC_LOG("picc_err_callback  \n");
        }
    }
    else
    {
        picc_set_idle();
    }
}

void picc_start(void)
{
    hal_nfc_bit_set(9, 0x3a, 1, 1);
}

void picc_stop(void)
{
    hal_nfc_bit_clear(9, 0x3a, 1, 1);
}

void picc_task(void)
{
    if (picc_run.en == PICC_MODE_ENABLE)
    {
        switch (picc_run.state)
        {
        case PICC_STATE_INIT:
            NFC_LOG("pt:ie\r\n");
            picc_init();
            NFC_LOG("pt:id\r\n");
            picc_run.state = PICC_STATE_START;
            break;
        case PICC_STATE_STOP:
            picc_stop();
            //   NFC_LOG("picc_stop\r\n");
            // NVIC_DisableIRQ(EXIT_IRQ_NUM);
            picc_run.state = PICC_STATE_IDLE;
            break;
        case PICC_STATE_START:
            NFC_LOG("pt:se\r\n");
            picc_start();
            NFC_LOG("pt:sd\r\n");
            // NVIC_EnableIRQ(EXIT_IRQ_NUM);
            picc_run.state = PICC_STATE_IDLE;
            // picc_14443_4_enable(picc_conf.enable_14443_4);
            break;
        case PICC_STATE_HALT:
            break;
        case PICC_STATE_IDLE:
            // NFC_LOG("PICC_STATE_IDLE\r\n");
            break;
        case PICC_STATE_ACTIVE:
            if (picc_conf.enable_14443_4)
            {
                picc_run.state = PICC_STATE_RATS;
            }
            else
            {
                NFC_LOG(" PICC_STATE_T2T\r\n");
                picc_run.state = PICC_STATE_T2T;
            }
            NFC_LOG(" picc_rx_irq\r\n");
            picc_rx_irq(1, picc_t2t_read_callback);
            break;
        case PICC_STATE_T2T:
        case PICC_STATE_RATS:
            break;
        case PICC_STATE_RECV_BLOCK:
            break;
        default:
            break;
        }
    }
}
